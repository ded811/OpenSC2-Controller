## lib/opensc2/Kconfig.hap
```kconfig
# Copyright (c) 2026 the OpenSC2-Controller authors
# SPDX-License-Identifier: MIT
#
# The haptics synthesiser and its outputs. Sourced from lib/opensc2/Kconfig inside "if OPENSC2".

DT_COMPAT_OPENSC2_HAPTICS_I2S := opensc2,haptics-i2s
DT_COMPAT_OPENSC2_HAPTICS_PWM_DAC := opensc2,haptics-pwm-dac
DT_CHOSEN_OPENSC2_HAPTICS_DRV2605 := opensc2,haptics-drv2605

menuconfig OPENSC2_HAPTICS_SYNTH
	bool "Haptics synthesiser: the output reports rendered for actuators"
	help
	  Render what Steam plays on the controller's four haptic actuators (rumble 0x80, pulse
	  trains, clicks, tones, sweeps, scripts and PCM streams 0x81..0x89) into sample blocks, as
	  the real controller's two sequencers do: the pads at 4 kHz (unsigned 8-bit, 32-frame
	  blocks), the grips at 8 kHz (signed 16-bit, 64-frame blocks), one thread each. The blocks go
	  to outputs the application sets with opensc2_haptics_set_output() or to the built-in ones
	  below; without an output a path still renders, paced by a timer, so the test hooks can check
	  it. Also plays OpenSC2's own built-in sounds (report 0x85's scripts, the cues, the drop
	  sounds) and sends the PCM streams' flow control (input report 0x44: 0x01, 0x02 when a
	  stream runs dry or is stopped, 0x04, 0x08, 0x10, 0x20, 0x40), every 0x02 that answers a
	  stop included, when its sequencer takes the stop, as the real controller sends it (so
	  OPENSC2_HAPTIC_STOP_STATUS has no effect with it). It also plays lizard mode's ticks and
	  pad clicks and the system state machine's cues. Settings 76 (master gain) and 75
	  (amplifier mode) reach the four channels as configure commands at the end of start-up
	  and whenever they change, as on the real controller; setting 27 feeds the rumble
	  emulation. The application's rumble and haptic callbacks are still called. About 10 KB of RAM (two thread stacks, four 512-byte stream rings,
	  the generators and queues) and 15 KB of flash. Built; not yet tested on hardware.

if OPENSC2_HAPTICS_SYNTH

config OPENSC2_HAPTICS_THREAD_PRIORITY
	int "Sequencer threads' priority"
	default 6
	help
	  Each path renders an 8 ms block ahead of what plays. Keep it below (numerically above) the
	  radio and USB threads (5) and above long-running application threads.

config OPENSC2_HAPTICS_THREAD_STACK_SIZE
	int "Sequencer thread stack size"
	default 1536

config OPENSC2_HAPTICS_QUEUE_DEPTH
	int "Commands a sequencer holds"
	default 20
	range 4 64
	help
	  As on the real controller (20): a command that finds the queue full is lost.

config OPENSC2_HAPTICS_DROP_SOUNDS
	bool "Drop sounds after a free fall"
	default y
	help
	  opensc2_haptics_free_fall() (the application's IMU saw a free fall): 250 ms later one of
	  two drop sounds of OpenSC2's own plays on the left grip, about half of the time, as on the
	  real controller; falls count again 5 s later. Nothing happens unless the application reports
	  free falls (the blank canvas does with an IMU, through opensc2_freefall_update()).

config OPENSC2_HAPTICS_OUT_I2S
	bool "Grips: an I2S amplifier (untested)"
	depends on $(dt_compat_enabled,$(DT_COMPAT_OPENSC2_HAPTICS_I2S))
	select I2S
	help
	  The grips' blocks to Zephyr's I2S driver as master, 16-bit stereo at 8 kHz (the left grip
	  on the left word), for an I2S class-D amplifier per channel or a stereo one. Set up from an
	  "opensc2,haptics-i2s" devicetree node: its i2s phandle and an optional enable-gpios for the
	  amplifier's shutdown pin. Built; not yet tested on hardware.

config OPENSC2_HAPTICS_OUT_PWM_DAC
	bool "Pads: PWM as a DAC on nrfx (untested)"
	depends on $(dt_compat_enabled,$(DT_COMPAT_OPENSC2_HAPTICS_PWM_DAC))
	depends on SOC_SERIES_NRF52
	select NRFX_PWM
	help
	  The pads' blocks played as duty cycles by an nRF PWM instance through nrfx's sequence
	  playback, timed as the real controller's: a 16 us period (256 steps of the 16 MHz clock,
	  the 8-bit sample the duty cycle itself), each sample held 16 periods, so the pads play
	  about 3906 samples a second (tones about 2.3 % flat); two sequences played in turn so one
	  fills while the other plays. Needs an H-bridge or a small amplifier and an RC filter per
	  pad. Set up from an "opensc2,haptics-pwm-dac" devicetree node: a PWM instance that
	  Zephyr's PWM driver does not use (disabled in the devicetree), the left and right pad
	  pins, an optional enable-gpios. Built; not yet tested on hardware.

config OPENSC2_HAPTICS_OUT_PWM_DAC_EXACT_4K
	bool "Pads' PWM DAC at exactly 4 kHz (not the real controller's 3906 Hz)"
	depends on OPENSC2_HAPTICS_OUT_PWM_DAC
	help
	  A 15.625 us period (250 steps) instead of 16 us, each sample scaled to 0..250 steps: the
	  pads play exactly 4000 samples a second, in tune, where the real controller plays them
	  about 2.3 % slow.

config OPENSC2_HAPTICS_OUT_DRV2605
	bool "One actuator on a DRV2605 in real-time playback (untested)"
	depends on $(dt_chosen_enabled,$(DT_CHOSEN_OPENSC2_HAPTICS_DRV2605))
	depends on DT_HAS_TI_DRV2605_ENABLED
	select HAPTICS
	help
	  A TI DRV2605(L) driving one ERM or LRA, through Zephyr's ti,drv2605 driver in real-time
	  playback: every 8 ms the louder of the two paths' block levels becomes the amplitude. Rumble,
	  clicks and pulses come through; tones, sweeps, chimes and PCM lose their pitch (the chip has
	  no drive-frequency control). Choose the drv2605 node as opensc2,haptics-drv2605. A path
	  that has an output of its own (the grips on an I2S amplifier, say) does not feed it.
	  Built; not yet tested on hardware.

endif # OPENSC2_HAPTICS_SYNTH
```

## lib/opensc2/Kconfig.liz
```kconfig
# Copyright (c) 2026 the OpenSC2-Controller authors
# SPDX-License-Identifier: MIT
#
# The input rules after the hardware test hooks' injection point, lizard mode's processing, and
# the radio's waiting reports (sourced from Kconfig, inside "if OPENSC2").

config OPENSC2_STICK_TOUCH_FALLBACK
	bool "A stick deflected beyond 12000 counts as touched"
	default y
	help
	  As on the real controller: while a stick lies further than 12000 (of 32767) from its
	  centre, measured with the controller's distance approximation (about 12200 along an axis,
	  12340 on a diagonal), its stick-touch bit is set in report 0x42, which also blanks that
	  side's pad (setting 82) and counts in lizard mode. Never while setting 46 asks for raw
	  stick output. Built; not yet tested on hardware.

config OPENSC2_PAD_BLANK_ON_STICK
	bool "Setting 82 blanks a pad in report 0x42 while its stick is touched"
	default y
	help
	  As on the real controller (setting 82, default 3: bit 0 left, bit 1 right): while the
	  thumb rests on a stick, the pad on that side reports no touch, no click, position 0, 0 and
	  no pressure, in report 0x42 as in lizard mode. The stick-touch and grip bits stay. Off:
	  only lizard mode ignores the pad. Built; not yet tested on hardware.

config OPENSC2_PAD_CLICK_AUTO
	bool "Set the pads' click bits from their pressure (settings 52, 53)"
	help
	  The real controller's pads have no switch: a pad clicks when its pressure passes setting
	  52 (left) or 53 (right), percent, default 40, -1 meaning 100, with 8 points of hysteresis
	  (on above 48 %, off below 32 % by default). With this option the library sets the click
	  bits that way from the pressure the application reports (0..32767 as the whole press),
	  replacing the application's own clicks. Off by default: a board with a physical click
	  keeps it, and a pressure that is not a real press (a constant while touched) would click on
	  every touch. Built; not yet tested on hardware.

config OPENSC2_LIZARD_STABILISER
	bool "Lizard mode: hold a new touch still until the thumb really moves"
	default y
	depends on OPENSC2_LIZARD_MODE
	help
	  The real controller's touch stabilisers in lizard mode: on the right pad while setting 80
	  is 1 (the default), with a hold radius of 4369 pad units, and on the left pad always, with
	  8738. A new touch neither moves the pointer nor scrolls until the thumb leaves that radius.
	  Built; not yet tested on hardware.

config OPENSC2_LIZARD_SMOOTHING
	bool "Lizard mode: average the motion over 8 frames"
	default y
	depends on OPENSC2_LIZARD_MODE
	help
	  As on the real controller: each frame's motion is the mean of the pad's newest 8 movements
	  (about 32 ms on the cable). Built; not yet tested on hardware.

config OPENSC2_LIZARD_GLIDE
	bool "Lizard mode: keep gliding after a flick (settings 11, 12)"
	default y
	depends on OPENSC2_LIZARD_MODE
	help
	  As on the real controller: a flick (a touch of more than 20 frames and more than 700 pad
	  units of travel whose speed is above setting 11) keeps the pointer gliding, or the page
	  scrolling, for setting 12 frames of steadily slowing motion, worked out in single precision
	  as the real controller does. A new touch on that pad, or lizard mode turning off, stops it.
	  Built; not yet tested on hardware.

config OPENSC2_LIZARD_TICKS
	bool "Lizard mode: haptic ticks and clicks on the pads (setting 14)"
	default y
	depends on OPENSC2_LIZARD_MODE
	help
	  As on the real controller, while lizard mode is on and setting 70 is 1: moving across a
	  pad makes a tick (click A at +8 dB) once the steps of 1500 pad units add up to more than
	  setting 14 (every fourth step at the default 5500), and each press and release of a pad's
	  click makes click B (+6 dB). Each one is an event for the haptic callback (report ID 0: made by the
	  library). With CONFIG_OPENSC2_HAPTICS_SYNTH the library also plays them itself on the
	  pads (while setting 70 is 1 and the dock is not the current link); the haptic callback
	  still gets them, so do not play them again on the synthesiser's actuators. Nothing plays
	  once Steam has turned lizard mode off. Built; not yet tested on hardware.

config OPENSC2_LIZARD_KEYS_AT_ONCE
	bool "Lizard mode: a key report the moment the buttons change"
	default y
	depends on OPENSC2_LIZARD_MODE
	help
	  As on the real controller, whose keyboard listens to its button driver: a change of a
	  mapped button that the application reports (opensc2_set_buttons(), opensc2_set_state(),
	  the sample callback) wakes a thread of the library's, and the keyboard report goes out
	  then, not with the next state report. A change while no link runs (or only the dock) goes
	  nowhere, as on the real controller: the first frames after the gap do not send it. Through
	  the puck a change waits while reports wait for room. While the hardware test hooks are
	  armed the frames bring the buttons either way. Off: the keyboard hears the buttons once per
	  state report (up to one frame later; a change made while no link runs is then sent by the
	  first frame after the gap), and the thread's stack is saved. Built; not yet tested on
	  hardware.

config OPENSC2_LIZARD_KEYS_STACK_SIZE
	int "Lizard mode: the keyboard thread's stack size"
	default 1536
	depends on OPENSC2_LIZARD_KEYS_AT_ONCE

config OPENSC2_LIZARD_KEYS_PRIORITY
	int "Lizard mode: the keyboard thread's priority (preemptible)"
	default 8
	depends on OPENSC2_LIZARD_KEYS_AT_ONCE
	help
	  The real controller's keyboard thread runs at 8, below its links' threads.

config OPENSC2_REPORT_WAIT_DEPTH
	int "Radio: lizard and application reports that wait when the report queue is full"
	default 0
	range 0 64
	help
	  Through the puck, extra input reports ride behind the state reports; up to
	  CONFIG_OPENSC2_REPORT_QUEUE_DEPTH of them queue. The real controller drops a report that
	  finds its queue full, lizard mode's included (0, the default). Above 0, OpenSC2's own
	  option: reports that must not be lost (lizard mode's, and opensc2_send_report()'s) wait
	  for room instead, up to this many more, while lizard mode waits with its next frame; a
	  battery report is still dropped. Built; not yet tested on hardware.
```
