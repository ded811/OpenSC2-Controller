## dts/bindings/haptics/opensc2,haptics-i2s.yaml
```yaml
# Copyright (c) 2026 the OpenSC2-Controller authors
# SPDX-License-Identifier: MIT

description: |
  OpenSC2's haptics synthesiser: the grips' blocks played by an I2S amplifier
  (CONFIG_OPENSC2_HAPTICS_OUT_I2S). The I2S controller runs as master, 16-bit stereo at 8 kHz, the
  left grip on the left word: one I2S class-D amplifier per channel (for example a MAX98357A set
  to the left or the right word) or a stereo one, each driving a wideband voice-coil exciter.
  Built; not yet tested on hardware.

    haptics_grips: haptics-grips {
            compatible = "opensc2,haptics-i2s";
            i2s = <&i2s0>;
            enable-gpios = <&gpio0 4 GPIO_ACTIVE_HIGH>;
    };

compatible: "opensc2,haptics-i2s"

properties:
  i2s:
    type: phandle
    required: true
    description: The I2S controller (enabled, with its pins in a pinctrl group).

  enable-gpios:
    type: phandle-array
    description: |
      The amplifier's enable (shutdown) pin: active while something plays, or always with
      controller setting 75 = 1.
```

## dts/bindings/haptics/opensc2,haptics-pwm-dac.yaml
```yaml
# Copyright (c) 2026 the OpenSC2-Controller authors
# SPDX-License-Identifier: MIT

description: |
  OpenSC2's haptics synthesiser: the pads' blocks played as duty cycles by an nRF PWM instance, a
  PWM "DAC" (CONFIG_OPENSC2_HAPTICS_OUT_PWM_DAC). Each 8-bit sample is held for 16 periods of
  15.625 us (250 steps of the 16 MHz clock): exactly 4 kHz. Silence is half duty. Needs an H-bridge
  or a small amplifier and an RC low-pass per pad. The instance must not be used by Zephyr's PWM
  driver: leave its node disabled. Built; not yet tested on hardware.

    haptics_pads: haptics-pads {
            compatible = "opensc2,haptics-pwm-dac";
            pwm = <&pwm3>;
            left-gpios = <&gpio0 2 GPIO_ACTIVE_HIGH>;
            right-gpios = <&gpio0 29 GPIO_ACTIVE_HIGH>;
    };

compatible: "opensc2,haptics-pwm-dac"

properties:
  pwm:
    type: phandle
    required: true
    description: A "nordic,nrf-pwm" instance whose node is disabled (nrfx drives it directly).

  left-gpios:
    type: phandle-array
    required: true
    description: The left pad's output pin.

  right-gpios:
    type: phandle-array
    required: true
    description: The right pad's output pin.

  enable-gpios:
    type: phandle-array
    description: |
      The driver's enable pin: active while something plays, or always with controller setting
      75 = 1.
```

## dts/bindings/opensc2,dock.yaml
```yaml
# Copyright (c) 2026 the OpenSC2-Controller authors
# SPDX-License-Identifier: MIT

description: |
  OpenSC2's dock link (CONFIG_OPENSC2_DOCK; built, UNTESTED on hardware): the UART and the pilot
  sense a board uses on Valve's puck's charging pads. The library finds the node through the
  alias opensc2-dock. app/dock.overlay is an example for the SuperMini nRF52840.

  The pads' voltages and loads have not been measured. Nothing may be connected to Valve's
  puck's pads without the owner's step-by-step go-ahead (docs/testing.md, The dock).

    aliases {
      opensc2-dock = &opensc2_dock;
    };
    opensc2_dock: opensc2-dock {
      compatible = "opensc2,dock";
      uart = <&uart1>;
      io-channels = <&adc 2>;
    };

compatible: "opensc2,dock"

include: base.yaml

properties:
  uart:
    type: phandle
    required: true
    description: |
      The dock's UART, with its async API on (CONFIG_UART_ASYNC_API, the instance's
      CONFIG_UART_<n>_ASYNC): 115200 baud, 8N1, no flow control. Its TX should leave the line
      alone between answers (open drain, or high impedance) and its RX have no pull: the puck's
      side holds the line.

  io-channels:
    description: |
      The pilot sense on an ADC channel (CONFIG_ADC): one channel on the pin that sees the
      pilot, with no divider, set up as gain 1/6 of the internal 0.6 V reference, 12 bits
      (3600 mV full scale). The pilot is present while a reading lies inside 2000 to 3300 mV.
      This or pilot-gpios.

  pilot-gpios:
    type: phandle-array
    description: |
      The pilot sense on a window comparator of the board's own instead of an ADC channel: an
      input that reads active while the pilot lies inside 2000 to 3300 mV (the real controller
      reads its pilot as such a line, made from its ADC). This or io-channels.

  plus-gpios:
    type: phandle-array
    description: |
      Optional: a digital input that reads active while the dock's + pad carries power (through
      a divider or a comparator of the board's own), for a board whose + does not reach the
      chip's VBUS pin. Without it the library takes VBUS as the dock's + too, as on the real
      controller, whose + and USB-C port share one supply input. Either way the supply rule
      runs on "a supply is present" (VBUS or this input): a supply that appears with the pilot
      present is the dock's power, any other USB power, and the system state machine takes that
      as its power source. A board whose + may meet a USB host's VBUS needs its own protection
      (the SuperMini has none: app/dock.overlay leaves + unconnected).
```
