## lib/opensc2/Kconfig.bat
```kconfig
# Copyright (c) 2026 the OpenSC2-Controller authors
# SPDX-License-Identifier: MIT
#
# The library's fuel gauge (<opensc2/battery.h>, battery.c, fuel_rules.c). Sourced from
# lib/opensc2/Kconfig.

config OPENSC2_BATTERY_GAUGE
	bool "The real controller's fuel gauge and charge control, run by the library"
	default y if OPENSC2_BATTERY
	help
	  opensc2_battery_start() hands the library the board's battery parts (a battery reading,
	  and optionally a charger's status, values and controls and a cut-off), and the library
	  runs the real controller's fuel gauge: a pass once a second, 40 readings with an average,
	  a level per direction kept over a warm reboot, the charge state machine with its supply
	  check, the charge window (mte/charge_level), and the battery cut-off at power-off. Costs a
	  thread (CONFIG_OPENSC2_BATTERY_GAUGE_STACK_SIZE) that only runs once started. Without it the
	  application sets the battery's fields itself (opensc2_set_battery()). Built; not yet tested
	  on hardware.

if OPENSC2_BATTERY_GAUGE

config OPENSC2_BATTERY_GAUGE_PRIORITY
	int "The fuel gauge's thread priority"
	default 9

config OPENSC2_BATTERY_GAUGE_STACK_SIZE
	int "The fuel gauge's thread stack size"
	default 1024

config OPENSC2_CHARGE_TARGET_MV
	int "Charge voltage target, mV"
	default 4120
	range 3400 4400
	help
	  The real controller charges to 4120 mV, and its gauge reads 100 % there (the discharging
	  curve's stretch). The gauge asks the board's charger for it (set_charge_voltage), and in
	  "not charging" a battery average at or above it counts as a finished charge.

config OPENSC2_CHARGE_HYSTERESIS_MV
	int "Added to the target during the supply check and a charge, mV"
	default 40
	range 0 200
	help
	  The real controller charges to 4160 mV once its supply check starts (4120 + 40), and its
	  charging curve reads 100 % there.

config OPENSC2_SUPPLY_CHECK_START_MV
	int "Supply check: the first input-voltage limit, mV"
	default 4600

config OPENSC2_SUPPLY_CHECK_STEP_MV
	int "Supply check: the limit is lowered by this, mV"
	default 100
	range 1 1000

config OPENSC2_SUPPLY_CHECK_MIN_MV
	int "Supply check: gives up when the limit reaches this, mV"
	default 4300

config OPENSC2_SUPPLY_CHECK_STEP_S
	int "Supply check: seconds per step"
	default 5
	range 1 600

config OPENSC2_SUPPLY_CHECK_REST_S
	int "Supply check: seconds of rest after it gave up (the 0x80 flag)"
	default 60
	range 1 3600

endif # OPENSC2_BATTERY_GAUGE
```

## lib/opensc2/Kconfig.ble
```kconfig
# Copyright (c) 2026 the OpenSC2-Controller authors
# SPDX-License-Identifier: MIT
#
# Bluetooth LE: the board as a Steam Controller 2 over Bluetooth. Sourced by Kconfig (inside
# "if OPENSC2"). The SuperMini app turns it on with app/ble.conf, which also sets the Bluetooth
# stack up the way this needs (docs/api.md, Bluetooth LE).

menuconfig OPENSC2_BLE
	bool "Bluetooth LE: a Steam Controller 2 over Bluetooth (28DE:1303) [not yet tested on hardware]"
	depends on BT_PERIPHERAL && BT_SMP && BT_LL_SOFTDEVICE
	select ESB_DYNAMIC_INTERRUPTS
	select MPSL_DYNAMIC_INTERRUPTS
	select BT_CTLR_SDC_EVENT_TRIGGER
	help
	  A third wireless transport next to the puck's two bonds: the board as a HID-over-GATT
	  Steam Controller 2 (the Device Information Service's PnP ID 28DE:1303), with the same
	  report map as on USB, the vendor commands on feature report 1, output reports, the
	  battery service, Just Works bonding with LE Secure Connections, lizard mode, and a state
	  report (0x45) at every connection event. Only one wireless transport runs at a time:
	  the stored one (user/wireless_transport 0 or 1 for Bluetooth), or the one chosen with
	  opensc2_select_transport() or "opensc2 transport ble". Needs the nRF Connect SDK's
	  SoftDevice Controller (peripheral) and Zephyr's host with SMP; ESB and MPSL take their
	  interrupts at run time so the radio can change hands, and MPSL stays initialised all
	  the time (BT_UNINIT_MPSL_ON_DISABLE must stay off).

if OPENSC2_BLE

config OPENSC2_BLE_NAME_PREFIX
	string "Device name before the unit serial"
	default "Steam Ctrl (BT) "
	help
	  The device name is this and the 13-character unit serial: "Steam Ctrl (BT) OSC..." by
	  default, 29 characters, the real controller's form. SDL's Android and Apple back ends
	  find a Steam Controller 2 by this name's beginning. A name over 29 characters is sent
	  cut (as a shortened name) in the scan response.

config OPENSC2_BLE_COMPANY_ID
	hex "Company ID of the advertised manufacturer data"
	default 0x055D
	range 0 0xFFFF
	help
	  0x055D is Valve's Bluetooth company ID, which the real controller advertises (with no
	  payload), used here to interoperate, as the USB IDs are (NOTICE.md).

config OPENSC2_BLE_PNP_VENDOR
	hex "PnP ID vendor (USB-IF assigned)"
	default 0x28DE
	range 0 0xFFFF

config OPENSC2_BLE_PNP_PRODUCT
	hex "PnP ID product"
	default 0x1303
	range 0 0xFFFF
	help
	  0x1303 is the Steam Controller 2 over Bluetooth (vendor command 0x83 still reports
	  0x1302, as the real controller does). Windows builds its HID device from this ID.

config OPENSC2_BLE_PNP_VERSION
	hex "PnP ID version"
	default 0x0100
	range 0 0xFFFF

config OPENSC2_BLE_MODEL
	string "Device Information: model number"
	default "Steam Controller"

config OPENSC2_BLE_MANUFACTURER
	string "Device Information: manufacturer name"
	default ""
	help
	  Empty, as in the October 2026 firmware (July's said "Valve Corporation"): the
	  characteristic is there with a value of length 0.

config OPENSC2_BLE_VENDOR_SERVICE
	bool "Valve's vendor GATT service (for SDL on Android and Apple platforms)"
	default y
	help
	  A second GATT service, UUIDs 100F6Cxx-1735-4313-B402-38567131E5F3, that mirrors the
	  HID service's reports as plain characteristics: the command channel (0x34), inputs
	  0x40 to 0x45 (0x75 to 0x7A) and outputs 0x80 to 0x89 (0xB5 to 0xBE), all encrypted,
	  sharing their values with the HID service. SDL's Android and Apple back ends talk to
	  the controller through it instead of the system's HID-over-GATT support. A report goes
	  out on the vendor characteristic when the host enabled its notifications there, else on
	  the HID service's.

config OPENSC2_BLE_ADV_WINDOW_S
	int "Advertising window, seconds (0: advertise until a host connects)"
	default 60
	range 0 3600
	help
	  Every start of advertising arms this window, as on the real controller (60 s): when it
	  ends without a connection, advertising stops, the link goes OFF with reason
	  OPENSC2_REASON_LISTEN_TIMEOUT and the application gets OPENSC2_POWER_WIRELESS_OFF (the
	  real controller turns off on battery and turns wireless off on USB power). A start
	  (opensc2_start(), a button in the blank canvas) advertises again. 0 keeps advertising
	  until a host connects (the puck radio's CONFIG_OPENSC2_LISTEN_TIMEOUT_S defaults to that).

config OPENSC2_BLE_THREAD_PRIORITY
	int "Bluetooth thread priority"
	default 6
	help
	  The thread that does all Bluetooth work in order: start and stop, advertising, the link's
	  events. Below the radio thread (5), which must stop first when the radio changes hands.

config OPENSC2_BLE_THREAD_STACK_SIZE
	int "Bluetooth thread stack size"
	default 2048

config OPENSC2_BLE_REPORT_THREAD_PRIORITY
	int "Bluetooth report thread priority"
	default 4
	help
	  The thread that builds a state report for every connection event and sends the other
	  input reports.

config OPENSC2_BLE_REPORT_THREAD_STACK_SIZE
	int "Bluetooth report thread stack size"
	default 1536

config OPENSC2_BLE_TX_QUEUE_DEPTH
	int "Input reports from other threads waiting for the report thread"
	default 8
	help
	  Battery reports, the application's reports, lizard mode's release reports from the
	  command path. State reports are built in the report thread itself.

config OPENSC2_BLE_REPORT_LEAD_US
	int "Build the state report this long before the next connection event, microseconds"
	default 500
	range 0 5000
	help
	  The real controller sets its report slot one connection interval after the start of each
	  connection event, less 500 us, so one fresh state report is ready for every event.

endif # OPENSC2_BLE
```

## lib/opensc2/Kconfig.cal
```kconfig
# Copyright (c) 2026 the OpenSC2-Controller authors
# SPDX-License-Identifier: MIT
#
# Calibration and sensor processing (lib/opensc2/cal_store.c and friends), sourced from Kconfig.

config OPENSC2_CAL
	bool "Calibration: the cal/ keys, the calibration commands and raw inputs"
	default y
	help
	  As on the real controller: the calibration keys (cal/joy_l, cal/joy_r, cal/trg_l,
	  cal/trg_r, cal/prs_l, cal/prs_r, cal/touch_l, cal/touch_r, cal/rgbw_r/_g/_b/_w,
	  cal/volt_offset, cal/sensors/gyroscope/bias) kept under "opensc2/cal/" in Zephyr settings,
	  read with vendor command 0xED and changed with 0xEE, 0xEF and 0xF0; the factory recordings
	  0xD8 (sticks), 0xC0 (triggers) and 0xC3 (pad pressure); 0xE2 (save one side) and 0xFE
	  (erase every cal/ key, only with its key). A factory reset (0x86) keeps them.

	  Raw inputs (opensc2_set_stick_raw() and friends, <opensc2/cal.h>): the library applies the
	  stored calibration and controller settings 30, 31, 34, 35, 46, 52, 53, 60 and 62 to raw ADC
	  counts, pressure and capacitive words at every state report, as the real controller does,
	  and the recordings take their samples from them. An application that gives finished values
	  only is not affected. About 400 bytes of RAM.

if OPENSC2_CAL

config OPENSC2_CAL_PRESSURE_CLICK
	bool "Raw pad pressure also sets the pad's click bit"
	default y
	help
	  As on the real controller, which has no click switch under its pads: the click follows the
	  calibrated pressure (settings 52 and 53, 8 points of hysteresis) while the pad is touched.
	  Turn off on a board whose pads have a click switch of their own and also report pressure.

config OPENSC2_CAL_STICK_DEAD_ZONE
	int "Centre dead zone of raw sticks, report units (0: none, as the real controller)"
	default 0
	range 0 16383
	help
	  Per axis: a calibrated value up to this reads 0, the rest is stretched back to full scale.
	  The real controller has none (its Hall sticks do not drift); potentiometer sticks may want
	  about 2000 (6 %).

config OPENSC2_CAL_STICK_GROW_RANGE
	bool "Raw sticks: let the range grow past the stored extremes (July 2026's rule)"
	help
	  July 2026's controller firmware let each half's outer end follow a low-pass copy of the
	  reading (factor 0.15) past the stored extreme, in RAM only; October keeps the stored range.

endif # OPENSC2_CAL

config OPENSC2_PAD_RULES
	bool "Pad rotation (settings 2 and 24) and stabiliser (setting 80 = 2) on the reported pads"
	default y
	depends on OPENSC2_CAL
	help
	  After the hardware test hooks' injection, as the real controller processes its pads: with
	  settings 2 and 24 both non-zero the pads' positions turn by setting 2's angle (the left pad
	  the other way), and with setting 80 = 2 the touch stabiliser holds a new touch still until
	  the thumb moves more than 4369 units. Both are off with the default settings (2 = 0,
	  80 = 1), so nothing changes until a host writes them. Report 0x42 and lizard mode see the
	  result.
```

## lib/opensc2/Kconfig.dock
```kconfig
# Copyright (c) 2026 the OpenSC2-Controller authors
# SPDX-License-Identifier: MIT
#
# The dock: the controller's end of Valve's puck's charging pads (docs/api.md, "The dock").
# Sourced from lib/opensc2/Kconfig, inside "if OPENSC2".

config OPENSC2_DOCK_LINK
	bool "Dock link: vendor commands and the state report over the puck's charging pads"
	default y if OPENSC2_TEST_HOOKS
	help
	  The dock's protocol, with no pins of its own: the 73-byte frames and their CRC, a
	  session (one request at a time; any frame that fails ends it), the probe's identity
	  record, vendor commands on a stored request of the dock's own (0x81 and 0x85 do nothing
	  there), the latest state report for GET input, attribute 11 of 0x83 = 64000 while the
	  dock is the only link, and the dock's pure rules (the pilot check, the supply rule, the
	  docked states). Its frames come from OPENSC2_DOCK's UART, or from the hardware test
	  hooks' dock ops, which test the protocol on a board with nothing wired; that is why it is
	  on by default with the hooks. While no session runs, nothing changes on USB or the radio.
	  About 3 KB of flash.

config OPENSC2_DOCK
	bool "Dock UART and pilot sense (BUILT, UNTESTED on hardware)"
	depends on $(dt_alias_enabled,opensc2-dock)
	depends on UART_ASYNC_API && ADC
	select OPENSC2_DOCK_LINK
	help
	  BUILT, NEVER RUN ON HARDWARE. Serves the puck's dock requests on a UART, 115200 baud 8N1,
	  and senses the pilot on an ADC channel (gain 1/6 of the internal reference, 12 bits, no
	  divider: present inside 2000 to 3300 mV at the pin), both named by the devicetree node
	  aliased opensc2-dock (compatible "opensc2,dock"). app/dock.conf and app/dock.overlay are
	  a SuperMini variant. The pads' voltages and loads have not been measured: nothing may be
	  connected to Valve's puck's pads without the owner's step-by-step go-ahead
	  (docs/testing.md, The dock). Needs the UART instance's async API
	  (CONFIG_UART_ASYNC_API, the instance's CONFIG_UART_<n>_ASYNC).

if OPENSC2_DOCK

config OPENSC2_DOCK_THREAD_PRIORITY
	int "Dock thread priority"
	default 9
	help
	  The real controller serves the dock at priority 9, just below its input sampling.

config OPENSC2_DOCK_THREAD_STACK_SIZE
	int "Dock thread stack size"
	default 2048
	help
	  The thread runs vendor commands, flash writes included (a pairing over the dock saves the
	  bond), as the USB stack's thread does on the cable (the blank canvas gives that one 2048
	  bytes for the same reason).

endif # OPENSC2_DOCK
```
