## CMakeLists.txt
```
# Copyright (c) 2026 the OpenSC2-Controller authors
# SPDX-License-Identifier: MIT
#
# The pure parts of the library (wire formats, USB descriptors and framing, when the wired link
# sends reports, lizard mode, the input rules, the radio's report queue, the mode rules, the
# retained area, settings, fusion) under ztest. They need no radio, so this suite runs on
# native_sim or any QEMU target:
#   west twister -T tests -p native_sim
# (The command-channel tests need stand-ins for the rest of the library: they run on a PC only,
# tests/host.)
cmake_minimum_required(VERSION 3.20.0)
find_package(Zephyr REQUIRED HINTS $ENV{ZEPHYR_BASE})
project(opensc2_codec_tests LANGUAGES C)

set(OPENSC2_ROOT ${CMAKE_CURRENT_LIST_DIR}/../..)
target_include_directories(app PRIVATE ${OPENSC2_ROOT}/include ${OPENSC2_ROOT}/lib/opensc2)
target_sources(app PRIVATE
	src/main.c
	${OPENSC2_ROOT}/lib/opensc2/codec.c
	${OPENSC2_ROOT}/lib/opensc2/input_rules.c
	${OPENSC2_ROOT}/lib/opensc2/lizard.c
	${OPENSC2_ROOT}/lib/opensc2/report_queue.c
	${OPENSC2_ROOT}/lib/opensc2/report_rules.c
	${OPENSC2_ROOT}/lib/opensc2/settings_defaults.c
	${OPENSC2_ROOT}/lib/opensc2/fusion.c
	${OPENSC2_ROOT}/lib/opensc2/usb_desc.c
	${OPENSC2_ROOT}/lib/opensc2/usb_rules.c
	${OPENSC2_ROOT}/lib/opensc2/mode_rules.c
	${OPENSC2_ROOT}/lib/opensc2/retained.c
	${OPENSC2_ROOT}/lib/opensc2/id_rules.c
	${OPENSC2_ROOT}/lib/opensc2/dock_codec.c
	${OPENSC2_ROOT}/lib/opensc2/dock_rules.c
)
```

## prj.conf
```kconfig
# Copyright (c) 2026 the OpenSC2-Controller authors
# SPDX-License-Identifier: MIT
CONFIG_ZTEST=y
```

## src/main.c
```c
/*
 * Copyright (c) 2026 the OpenSC2-Controller authors
 * SPDX-License-Identifier: MIT
 *
 * The pure test cases (cases.h, cases_usb.h, cases_input.h, cases_dock.h) as a Zephyr ztest suite.
 */
#include <zephyr/ztest.h>

#define OPENSC2_TEST(name) ZTEST(opensc2_codec, test_##name)
#define CHECK(cond) zassert_true(cond, "%s", #cond)
#define CHECK_EQ(a, b)                                                                  \
	zassert_equal((long long)(a), (long long)(b), "%s == %s (%lld != %lld)", #a, #b,  \
		      (long long)(a), (long long)(b))

#include "cases.h"
#include "cases_usb.h"
#include "cases_input.h"
#include "cases_dock.h"

ZTEST_SUITE(opensc2_codec, NULL, NULL, NULL, NULL, NULL);
```

## src/cases_dock.h
```c
/*
 * Copyright (c) 2026 the OpenSC2-Controller authors
 * SPDX-License-Identifier: MIT
 *
 * Test cases for the dock's pure parts: the frame codec (dock_codec.c) and the dock's rules
 * (dock_rules.c: the answer to a frame, the pilot check, the supply rule, the docked states).
 * Written once, run two ways, like cases.h: a Zephyr ztest suite (tests/codec) and the host tests
 * (tests/host, which also run tests/vectors/hwtest/dock.txt through the same functions). The
 * values are the protocol documentation's (not public yet; docs/protocol.md lists its pages).
 */
#include <string.h>
#include <opensc2/codec.h>
#include <opensc2/dock.h>
#include "dock_rules.h"

/* ---- the frames ------------------------------------------------------------------------------ */

OPENSC2_TEST(dock_crc)
{
	static const uint8_t check[] = "123456789";
	uint8_t frame[OPENSC2_DOCK_FRAME_LEN] = { 0x5A, 0x00 };

	CHECK_EQ(opensc2_dock_crc16(0, check, 9), 0x2189);
	/* in two parts: the running value carries over */
	CHECK_EQ(opensc2_dock_crc16(opensc2_dock_crc16(0, check, 4), &check[4], 5), 0x2189);
	CHECK_EQ(opensc2_dock_crc16(0, check, 0), 0);
	/* the documentation's two examples */
	CHECK_EQ(opensc2_dock_crc16(0, frame, 71), 0x9BD0);
	frame[1] = 0x03;
	CHECK_EQ(opensc2_dock_crc16(0, frame, 71), 0x3BA7);
}

OPENSC2_TEST(dock_frames)
{
	static const uint8_t payload[3] = { 0x83, 0x00, 0x00 };
	uint8_t f[OPENSC2_DOCK_FRAME_LEN];

	CHECK_EQ(opensc2_dock_build_request(OPENSC2_DOCK_PROBE, NULL, 0, f), 73);
	CHECK_EQ(f[0], 0x5A);
	CHECK_EQ(f[1], 0);
	CHECK_EQ(f[71], 0xD0);   /* low byte first */
	CHECK_EQ(f[72], 0x9B);
	CHECK_EQ(opensc2_dock_frame_check(f, 73), OPENSC2_DOCK_FRAME_OK);
	CHECK_EQ(opensc2_dock_frame_check(f, 72), OPENSC2_DOCK_FRAME_BAD_SIZE);
	CHECK_EQ(opensc2_dock_frame_check(f, 0), OPENSC2_DOCK_FRAME_BAD_SIZE);
	f[40] ^= 0x10;
	CHECK_EQ(opensc2_dock_frame_check(f, 73), OPENSC2_DOCK_FRAME_BAD_CRC);
	f[40] ^= 0x10;
	f[0] = 0xAC;   /* the start byte is covered by the CRC (and checked by nobody) */
	CHECK_EQ(opensc2_dock_frame_check(f, 73), OPENSC2_DOCK_FRAME_BAD_CRC);
	opensc2_dock_frame_seal(f, 0xAC);
	CHECK_EQ(opensc2_dock_frame_check(f, 73), OPENSC2_DOCK_FRAME_OK);

	CHECK_EQ(opensc2_dock_build_request(OPENSC2_DOCK_SET, payload, sizeof(payload), f), 73);
	CHECK_EQ(f[1], 2);
	CHECK_EQ(f[8], 0x83);
	CHECK_EQ(f[11], 0);
	CHECK_EQ(opensc2_dock_frame_check(f, 73), OPENSC2_DOCK_FRAME_OK);
	CHECK_EQ(opensc2_dock_build_request(OPENSC2_DOCK_SET, f, 64, f), 0);   /* too long */
}

/* ---- one frame in, one answer out ------------------------------------------------------------ */

struct fake_dock {
	int identity, set, get, input;
	uint8_t set_rec[OPENSC2_DOCK_PAYLOAD_LEN];
	int32_t set_rc, get_rc;
};

static void fake_identity(void *ctx, uint8_t out[OPENSC2_IDENTITY_RECORD_LEN])
{
	struct fake_dock *f = ctx;

	f->identity++;
	for (int i = 0; i < OPENSC2_IDENTITY_RECORD_LEN; i++) {
		out[i] = (uint8_t)(0x10 + i);
	}
}

static int32_t fake_set(void *ctx, const uint8_t rec[OPENSC2_DOCK_PAYLOAD_LEN])
{
	struct fake_dock *f = ctx;

	f->set++;
	memcpy(f->set_rec, rec, OPENSC2_DOCK_PAYLOAD_LEN);
	return f->set_rc;
}

static int32_t fake_get(void *ctx, uint8_t out[OPENSC2_DOCK_PAYLOAD_LEN])
{
	struct fake_dock *f = ctx;

	f->get++;
	out[0] = 0x89;
	out[1] = 3;
	out[2] = 45;
	out[3] = 50;
	return f->get_rc;
}

static void fake_input(void *ctx, uint8_t out[OPENSC2_STATE_REPORT_LEN - 1])
{
	struct fake_dock *f = ctx;

	f->input++;
	memset(out, 0x42, OPENSC2_STATE_REPORT_LEN - 1);
}

static const struct osc2_dock_ops fake_ops = {
	.identity = fake_identity,
	.set = fake_set,
	.get = fake_get,
	.input = fake_input,
};

OPENSC2_TEST(dock_answers)
{
	struct fake_dock f;
	uint8_t req[OPENSC2_DOCK_FRAME_LEN], ans[OPENSC2_DOCK_FRAME_LEN], before[OPENSC2_DOCK_FRAME_LEN];
	static const uint8_t set87[] = { 0x87, 3, 45, 50, 0 };

	/* Every answer is built over the previous one (here 0xEE everywhere, a stand-in for what a
	 * boot leaves): only what the request defines is written, then 0xAC and the CRC. */

	/* a probe: the identity record over the first 57 payload bytes; type, result, bytes 2 and
	 * 3 and the payload's last 6 bytes stay */
	memset(&f, 0, sizeof(f));
	memset(ans, 0xEE, sizeof(ans));
	(void)opensc2_dock_build_request(OPENSC2_DOCK_PROBE, NULL, 0, req);
	CHECK_EQ(osc2_dock_answer(req, 73, ans, &fake_ops, &f), OSC2_DOCK_ANSWERED);
	CHECK_EQ(f.identity, 1);
	CHECK_EQ(ans[0], 0xAC);
	CHECK_EQ(ans[1], 0xEE);
	CHECK_EQ(opensc2_get_le32(&ans[4]), 0xEEEEEEEEu);
	CHECK_EQ(ans[8], 0x10);
	CHECK_EQ(ans[8 + 56], 0x10 + 56);
	CHECK_EQ(ans[8 + 57], 0xEE);
	CHECK_EQ(ans[8 + 62], 0xEE);
	CHECK_EQ(opensc2_dock_frame_check(ans, 73), OPENSC2_DOCK_FRAME_OK);

	/* a SET: the 63 payload bytes go to the command channel; its type and result; the payload
	 * stays the previous answer's (the probe's record) */
	memset(&f, 0, sizeof(f));
	f.set_rc = -22;
	(void)opensc2_dock_build_request(OPENSC2_DOCK_SET, set87, sizeof(set87), req);
	CHECK_EQ(osc2_dock_answer(req, 73, ans, &fake_ops, &f), OSC2_DOCK_ANSWERED);
	CHECK_EQ(f.set, 1);
	CHECK(memcmp(f.set_rec, set87, sizeof(set87)) == 0);
	CHECK_EQ(ans[1], 2);
	CHECK_EQ((int32_t)opensc2_get_le32(&ans[4]), -22);
	CHECK_EQ(ans[2], 0xEE);
	CHECK_EQ(ans[8], 0x10);
	CHECK_EQ(ans[8 + 62], 0xEE);

	/* a GET: its type, its result, the payload as the op leaves it */
	memset(&f, 0, sizeof(f));
	f.get_rc = OSC2_DOCK_RESULT_GET_OK;
	(void)opensc2_dock_build_request(OPENSC2_DOCK_GET, set87, sizeof(set87), req);
	CHECK_EQ(osc2_dock_answer(req, 73, ans, &fake_ops, &f), OSC2_DOCK_ANSWERED);
	CHECK_EQ(f.get, 1);
	CHECK_EQ(f.set, 0);   /* a GET's payload is ignored */
	CHECK_EQ(ans[1], 1);
	CHECK_EQ(opensc2_get_le32(&ans[4]), 63);
	CHECK_EQ(ans[8], 0x89);
	CHECK_EQ(ans[9], 3);
	CHECK_EQ(ans[8 + 10], 0x10 + 10);   /* the op wrote 5 bytes; the record's after them */

	/* GET input: the 53 bytes, type 3, result 0; the last 10 stay */
	memset(&f, 0, sizeof(f));
	(void)opensc2_dock_build_request(OPENSC2_DOCK_INPUT, NULL, 0, req);
	CHECK_EQ(osc2_dock_answer(req, 73, ans, &fake_ops, &f), OSC2_DOCK_ANSWERED);
	CHECK_EQ(f.input, 1);
	CHECK_EQ(ans[1], 3);
	CHECK_EQ(opensc2_get_le32(&ans[4]), 0);
	CHECK_EQ(ans[8], 0x42);
	CHECK_EQ(ans[8 + 52], 0x42);
	CHECK_EQ(ans[8 + 53], 0x10 + 53);
	CHECK_EQ(ans[8 + 62], 0xEE);

	/* another type: the previous answer again byte for byte, nothing asked of the library */
	memset(&f, 0, sizeof(f));
	memcpy(before, ans, sizeof(before));
	(void)opensc2_dock_build_request(4, NULL, 0, req);
	CHECK_EQ(osc2_dock_answer(req, 73, ans, &fake_ops, &f), OSC2_DOCK_ANSWERED);
	CHECK_EQ(f.identity + f.set + f.get + f.input, 0);
	CHECK(memcmp(before, ans, sizeof(before)) == 0);

	/* the start byte and bytes 2 to 7 of a request are ignored */
	(void)opensc2_dock_build_request(OPENSC2_DOCK_INPUT, NULL, 0, req);
	req[0] = 0x00;
	req[2] = 0xFF;
	req[7] = 0x80;
	opensc2_dock_frame_seal(req, 0x11);
	CHECK_EQ(osc2_dock_answer(req, 73, ans, &fake_ops, &f), OSC2_DOCK_ANSWERED);
	CHECK_EQ(ans[0], 0xAC);
	CHECK_EQ(ans[1], 3);
	CHECK_EQ(ans[2], 0xEE);

	/* a short frame or a bad CRC: no answer, nothing asked, `ans` left alone */
	memset(&f, 0, sizeof(f));
	memset(ans, 0xEE, sizeof(ans));
	(void)opensc2_dock_build_request(OPENSC2_DOCK_PROBE, NULL, 0, req);
	CHECK_EQ(osc2_dock_answer(req, 72, ans, &fake_ops, &f), OSC2_DOCK_BAD_SIZE);
	req[30] = 1;
	CHECK_EQ(osc2_dock_answer(req, 73, ans, &fake_ops, &f), OSC2_DOCK_BAD_CRC);
	CHECK_EQ(f.identity, 0);
	CHECK_EQ(ans[0], 0xEE);
}

/* ---- the pilot, the supply, the docked states ------------------------------------------------ */

OPENSC2_TEST(dock_pilot)
{
	int32_t in[3] = { 2500, 1500, 3300 };
	int32_t one[3] = { 2000, -1, 3301 };
	uint8_t inside = 0xFF;

	CHECK_EQ(osc2_dock_pilot_mv(2276), 2000);
	CHECK_EQ(osc2_dock_pilot_mv(4095), 3599);
	CHECK_EQ(osc2_dock_pilot_mv(-5), -1);
	CHECK(osc2_dock_pilot_in_window(2000));
	CHECK(osc2_dock_pilot_in_window(3300));
	CHECK(!osc2_dock_pilot_in_window(1999));
	CHECK(!osc2_dock_pilot_in_window(3301));
	CHECK(!osc2_dock_pilot_in_window(-1));
	CHECK(osc2_dock_pilot_present(in, &inside));
	CHECK_EQ(inside, 0x05);
	CHECK(!osc2_dock_pilot_present(one, &inside));
	CHECK_EQ(inside, 0x01);
	CHECK(!osc2_dock_pilot_present(one, NULL));
}

OPENSC2_TEST(dock_supply)
{
	struct osc2_dock_power_rule r;
	struct osc2_dock_power_in none = { 0 }, usb = { .usb = true }, dock = { .plus = true,
										 .pilot = true };

	memset(&r, 0, sizeof(r));
	/* the first reading posts, also "nothing" */
	CHECK_EQ(osc2_dock_power_step(&r, &none), OSC2_DOCK_SUPPLY_NONE);
	CHECK_EQ(osc2_dock_power_step(&r, &none), -1);
	CHECK_EQ(osc2_dock_power_step(&r, &dock), OSC2_DOCK_SUPPLY_DOCK);
	CHECK_EQ(osc2_dock_power_step(&r, &dock), -1);
	/* from the dock to a cable with power all along: nothing, it stays the dock */
	CHECK_EQ(osc2_dock_power_step(&r, &usb), -1);
	CHECK_EQ(r.kind, OSC2_DOCK_SUPPLY_DOCK);
	CHECK_EQ(osc2_dock_power_step(&r, &none), OSC2_DOCK_SUPPLY_NONE);
	CHECK_EQ(osc2_dock_power_step(&r, &usb), OSC2_DOCK_SUPPLY_USB);
	dock.pilot = false;
	CHECK_EQ(osc2_dock_supply_kind(&dock), OSC2_DOCK_SUPPLY_USB);   /* + without the pilot */
	/* VBUS with the pilot is the dock (the real controller's + reaches VBUS) */
	usb.pilot = true;
	CHECK_EQ(osc2_dock_supply_kind(&usb), OSC2_DOCK_SUPPLY_DOCK);
	/* only a change of "a supply is present" posts, and asks for a pilot check */
	memset(&r, 0, sizeof(r));
	CHECK(osc2_dock_power_posts(&r, false, false));
	CHECK_EQ(osc2_dock_power_step(&r, &none), OSC2_DOCK_SUPPLY_NONE);
	CHECK(!osc2_dock_power_posts(&r, false, false));
	CHECK(osc2_dock_power_posts(&r, true, false));
	CHECK(osc2_dock_power_posts(&r, false, true));
	CHECK_EQ(osc2_dock_power_step(&r, &usb), OSC2_DOCK_SUPPLY_DOCK);
	CHECK(!osc2_dock_power_posts(&r, false, true));
}

OPENSC2_TEST(dock_states)
{
	struct osc2_dock_sm sm;
	struct osc2_dock_step st;

	/* a cold power-on on the dock, a chord, its release, turned off again, lifted, back */
	osc2_dock_sm_init(&sm);
	osc2_dock_sm_step(&sm, OSC2_DOCK_EV_POWER_DOCK, 0, &st);
	CHECK(!st.handled);   /* outside the dock states: the caller enters them */
	osc2_dock_sm_enter(&sm, OSC2_DOCK_AT_POWER_ON, false, &st);
	CHECK_EQ(st.to, OSC2_DOCK_RADIO_OFF);
	CHECK_EQ(st.actions, OSC2_DOCK_DO_KEYLOCK_CLEAR | OSC2_DOCK_DO_LED_CHARGING |
			     OSC2_DOCK_DO_OFFSETS_ON);
	osc2_dock_sm_step(&sm, OSC2_DOCK_EV_REBOOT, 0, &st);
	CHECK(!st.handled);   /* a plain reboot does nothing on the dock with the radio off */
	osc2_dock_sm_step(&sm, OSC2_DOCK_EV_CHORD, OSC2_DOCK_CHORD_PUCK1, &st);
	CHECK_EQ(st.to, OSC2_DOCK_CHORD);
	CHECK(st.actions & OSC2_DOCK_DO_TIMER_4S);
	osc2_dock_sm_step(&sm, OSC2_DOCK_EV_CHORD_UP, OSC2_DOCK_CHORD_BT1, &st);
	CHECK(!st.handled);   /* not its chord */
	osc2_dock_sm_step(&sm, OSC2_DOCK_EV_CHORD_UP, OSC2_DOCK_CHORD_PUCK1, &st);
	CHECK_EQ(st.to, OSC2_DOCK_LINK_UP);
	CHECK(st.actions & OSC2_DOCK_DO_START_LINK);
	CHECK(!(st.actions & OSC2_DOCK_DO_PAIRING));
	osc2_dock_sm_step(&sm, OSC2_DOCK_EV_TURN_OFF, 0, &st);
	CHECK_EQ(st.to, OSC2_DOCK_RADIO_OFF);
	CHECK(st.actions & OSC2_DOCK_DO_CHIME_OFF);
	CHECK(st.actions & OSC2_DOCK_DO_STOP_LINK);
	CHECK(!(st.actions & OSC2_DOCK_DO_SHUTDOWN));   /* never a power-off on the dock */
	osc2_dock_sm_step(&sm, OSC2_DOCK_EV_POWER_GONE, 0, &st);
	CHECK_EQ(st.to, OSC2_DOCK_LIFTED);
	CHECK(st.actions & OSC2_DOCK_DO_TIMER_5S);
	CHECK(st.actions & OSC2_DOCK_DO_OFFSETS_OFF);   /* the docked stick offsets go */
	osc2_dock_sm_step(&sm, OSC2_DOCK_EV_POWER_DOCK, 0, &st);
	CHECK_EQ(st.to, OSC2_DOCK_RADIO_OFF);
	/* lifted off for good: 5 s, then off */
	osc2_dock_sm_step(&sm, OSC2_DOCK_EV_POWER_GONE, 0, &st);
	osc2_dock_sm_step(&sm, OSC2_DOCK_EV_TIMER, 0, &st);
	CHECK_EQ(st.to, OSC2_DOCK_AWAY);
	CHECK_EQ(st.actions, OSC2_DOCK_DO_TIMER_STOP | OSC2_DOCK_DO_SHUTDOWN);

	/* placed on the dock with the link up, STEAM held 4 s on the dock: pairing flag */
	osc2_dock_sm_init(&sm);
	osc2_dock_sm_enter(&sm, OSC2_DOCK_ON_BATTERY, false, &st);
	CHECK_EQ(st.to, OSC2_DOCK_LINK_UP);
	osc2_dock_sm_step(&sm, OSC2_DOCK_EV_POWER_GONE, 0, &st);
	CHECK_EQ(st.to, OSC2_DOCK_AWAY);
	CHECK_EQ(st.actions, OSC2_DOCK_DO_TO_BATTERY | OSC2_DOCK_DO_OFFSETS_OFF);
	osc2_dock_sm_enter(&sm, OSC2_DOCK_AT_POWER_ON, true, &st);   /* a warm boot on the dock */
	CHECK_EQ(st.to, OSC2_DOCK_LINK_UP);
	CHECK(st.actions & OSC2_DOCK_DO_START_LINK);
	CHECK(!(st.actions & OSC2_DOCK_DO_CUE));
}
```

## src/cases_input.h
```c
/*
 * Copyright (c) 2026 the OpenSC2-Controller authors
 * SPDX-License-Identifier: MIT
 *
 * Test cases for the input rules after the injection point (input_rules.c), the touch stabiliser,
 * the parts of lizard mode's processing the shared vectors do not reach (its haptic events, what
 * ends a glide), and the radio's queue of extra reports (report_queue.c). Written once, run two
 * ways, like cases.h: as a Zephyr ztest suite (tests/codec) and as a plain C program on a PC
 * (tests/host). The including file defines OPENSC2_TEST(name), CHECK(cond) and CHECK_EQ(a, b).
 *
 * The expected values follow the real controller's behaviour as the protocol documentation (not
 * public yet; docs/protocol.md lists its pages) describes it, worked out by hand.
 */
#include <errno.h>
#include <string.h>
#include <opensc2/codec.h>
#include <opensc2/settings.h>
#include "input_rules.h"
#include "lizard.h"
#include "report_queue.h"

static void in_defaults(int16_t settings[OPENSC2_SETTINGS_COUNT])
{
	for (int i = 0; i < OPENSC2_SETTINGS_COUNT; i++) {
		settings[i] = opensc2_setting_default((uint8_t)i);
	}
}

/* ---- the distance approximation and the stick-touch fallback -------------------------------- */

OPENSC2_TEST(input_approx_len)
{
	CHECK_EQ(osc2_approx_len(0, 0), 0);
	/* Along an axis 1007/1024 of the length: 12203 is 12000, 12204 is 12001. */
	CHECK_EQ(osc2_approx_len(12203, 0), 12000);
	CHECK_EQ(osc2_approx_len(0, -12204), 12001);
	/* On a diagonal (M < 16 m) 1408/1024: 8727 is 12000, 8728 is 12001. */
	CHECK_EQ(osc2_approx_len(8727, -8727), 12000);
	CHECK_EQ(osc2_approx_len(-8728, 8728), 12001);
	/* M = 16 m: no correction; M just below: the correction. */
	CHECK_EQ(osc2_approx_len(1600, 100), (1007 * 1600 + 441 * 100 + 512) / 1024);
	CHECK_EQ(osc2_approx_len(1599, 100), (1007 * 1599 + 441 * 100 - 40 * 1599 + 512) / 1024);
	/* The largest differences of two pad positions do not overflow. */
	CHECK_EQ(osc2_approx_len(65534, -65534), (1408 * 65534 + 512) / 1024);
	CHECK_EQ(osc2_approx_len(-32768, 0), (1007 * 32768 + 512) / 1024);
}

OPENSC2_TEST(input_stick_fallback)
{
	struct osc2_input_rules r;
	struct opensc2_state s;
	int16_t settings[OPENSC2_SETTINGS_COUNT];

	in_defaults(settings);
	osc2_input_rules_reset(&r);
	memset(&s, 0, sizeof(s));
	s.stick[OPENSC2_LEFT].x = 12204;
	s.stick[OPENSC2_RIGHT].y = -12203;
	osc2_input_rules_apply(&r, OSC2_RULE_STICK_FALLBACK, settings, &s);
	CHECK_EQ(s.buttons, OPENSC2_TOUCH_LEFT_STICK);
	/* Without the rule, or with raw sticks (46 = 1 or 2): nothing. */
	memset(&s, 0, sizeof(s));
	s.stick[OPENSC2_LEFT].x = 30000;
	osc2_input_rules_apply(&r, 0, settings, &s);
	CHECK_EQ(s.buttons, 0);
	settings[OPENSC2_SETTING_RAW_STICKS] = 1;
	osc2_input_rules_apply(&r, OSC2_RULE_STICK_FALLBACK, settings, &s);
	CHECK_EQ(s.buttons, 0);
	/* No hysteresis: back under 12000, the bit goes (the application's own bit stays). */
	settings[OPENSC2_SETTING_RAW_STICKS] = 0;
	s.stick[OPENSC2_LEFT].x = 12000;
	s.buttons = OPENSC2_TOUCH_RIGHT_STICK;
	osc2_input_rules_apply(&r, OSC2_RULE_STICK_FALLBACK, settings, &s);
	CHECK_EQ(s.buttons, OPENSC2_TOUCH_RIGHT_STICK);
}

/* ---- the pads' clicks by pressure ----------------------------------------------------------- */

OPENSC2_TEST(input_pad_click)
{
	/* 40: on above 48 % (15728.16 of 32767), off below 32 % (10485.44). */
	CHECK(!osc2_pad_click(15728, 40, false));
	CHECK(osc2_pad_click(15729, 40, false));
	CHECK(osc2_pad_click(10486, 40, true));
	CHECK(!osc2_pad_click(10485, 40, true));
	CHECK(!osc2_pad_click(12000, 40, false));   /* in between: kept */
	CHECK(osc2_pad_click(12000, 40, true));
	/* -1 counts as 100, and anything below it as -1: never on, off below 92 %. */
	CHECK(!osc2_pad_click(32767, -1, false));
	CHECK(!osc2_pad_click(65535, -7, false));
	CHECK(osc2_pad_click(30146, -1, true));
	CHECK(!osc2_pad_click(30145, -1, true));
	/* Above 100: 100. */
	CHECK(!osc2_pad_click(32767, 300, false));
	CHECK(!osc2_pad_click(30145, 300, true));
	/* Below 9 the click can only end with a new threshold: 0 is on above 8 %, never off. */
	CHECK(osc2_pad_click(2622, 0, false));
	CHECK(osc2_pad_click(0, 0, true));
	CHECK(osc2_pad_click(0, 8, true));
	CHECK(!osc2_pad_click(0, 9, true));
}

OPENSC2_TEST(input_pad_click_rule)
{
	struct osc2_input_rules r;
	struct opensc2_state s;
	int16_t settings[OPENSC2_SETTINGS_COUNT];
	const uint32_t rules = OSC2_RULE_PAD_CLICK | OSC2_RULE_PAD_BLANK;

	in_defaults(settings);
	osc2_input_rules_reset(&r);
	memset(&s, 0, sizeof(s));
	/* Pressed while not touched: the click follows the pressure but is not reported. */
	s.pad[OPENSC2_RIGHT].pressure = 20000;
	osc2_input_rules_apply(&r, rules, settings, &s);
	CHECK_EQ(s.buttons & OPENSC2_CLICK_RIGHT_PAD, 0);
	CHECK(!s.pad[OPENSC2_RIGHT].clicked);
	CHECK(r.pad_click[OPENSC2_RIGHT]);
	/* Touched: reported, also with the pad's flag (no button bit) as the touch. */
	s.pad[OPENSC2_RIGHT].touched = true;
	osc2_input_rules_apply(&r, rules, settings, &s);
	CHECK(s.pad[OPENSC2_RIGHT].clicked);
	CHECK(s.buttons & OPENSC2_CLICK_RIGHT_PAD);
	/* A new threshold clears it: at 60 % the same press is in between, so it stays off. */
	settings[OPENSC2_SETTING_RIGHT_CLICK_PRESSURE] = 60;
	s.pad[OPENSC2_RIGHT].pressure = 18000;
	s.buttons = 0;
	osc2_input_rules_apply(&r, rules, settings, &s);
	CHECK(!s.pad[OPENSC2_RIGHT].clicked);
	CHECK_EQ(s.buttons & OPENSC2_CLICK_RIGHT_PAD, 0);
	/* The application's click is replaced, on the left pad too. */
	s.buttons = OPENSC2_TOUCH_LEFT_PAD | OPENSC2_CLICK_LEFT_PAD;
	s.pad[OPENSC2_LEFT].clicked = true;
	osc2_input_rules_apply(&r, rules, settings, &s);
	CHECK_EQ(s.buttons & OPENSC2_CLICK_LEFT_PAD, 0);
	CHECK(!s.pad[OPENSC2_LEFT].clicked);
	/* A blanked pad (setting 82, the stick touched) reports no click, while the click follows
	 * the pressure. */
	settings[OPENSC2_SETTING_RIGHT_CLICK_PRESSURE] = 40;
	s.buttons = OPENSC2_TOUCH_RIGHT_STICK | OPENSC2_TOUCH_RIGHT_PAD;
	s.pad[OPENSC2_RIGHT].pressure = 32767;
	osc2_input_rules_apply(&r, rules, settings, &s);
	CHECK(r.pad_click[OPENSC2_RIGHT]);
	CHECK_EQ(s.buttons, OPENSC2_TOUCH_RIGHT_STICK);
	CHECK(!s.pad[OPENSC2_RIGHT].clicked);
	CHECK_EQ(s.pad[OPENSC2_RIGHT].pressure, 0);
	/* The rule off: the application's click passes and the memory is cleared. */
	s.buttons = OPENSC2_TOUCH_RIGHT_PAD | OPENSC2_CLICK_RIGHT_PAD;
	osc2_input_rules_apply(&r, 0, settings, &s);
	CHECK(s.buttons & OPENSC2_CLICK_RIGHT_PAD);
	CHECK(!r.pad_click[OPENSC2_RIGHT]);
}

/* ---- setting 82 and the triggers ------------------------------------------------------------ */

OPENSC2_TEST(input_blank_and_triggers)
{
	struct osc2_input_rules r;
	struct opensc2_state s;
	int16_t settings[OPENSC2_SETTINGS_COUNT];

	in_defaults(settings);
	osc2_input_rules_reset(&r);
	memset(&s, 0, sizeof(s));
	/* The left stick by the fallback blanks the left pad; the grip bit stays. */
	s.stick[OPENSC2_LEFT].x = -20000;
	s.buttons = OPENSC2_TOUCH_LEFT_PAD | OPENSC2_CLICK_LEFT_PAD | OPENSC2_TOUCH_LEFT_GRIP;
	s.pad[OPENSC2_LEFT] = (struct opensc2_trackpad){ .x = 100, .y = -100, .pressure = 900,
							 .touched = true, .clicked = true };
	osc2_input_rules_apply(&r, OSC2_RULES_DEFAULT, settings, &s);
	CHECK_EQ(s.buttons, OPENSC2_TOUCH_LEFT_STICK | OPENSC2_TOUCH_LEFT_GRIP);
	CHECK(!s.pad[OPENSC2_LEFT].touched);
	CHECK(!s.pad[OPENSC2_LEFT].clicked);
	CHECK_EQ(s.pad[OPENSC2_LEFT].x, 0);
	CHECK_EQ(s.pad[OPENSC2_LEFT].pressure, 0);
	/* Raw pressure (60 = 1) passes. */
	settings[OPENSC2_SETTING_RAW_PRESSURE] = 1;
	s.pad[OPENSC2_LEFT].pressure = 900;
	osc2_input_rules_apply(&r, OSC2_RULES_DEFAULT, settings, &s);
	CHECK_EQ(s.pad[OPENSC2_LEFT].pressure, 900);
	settings[OPENSC2_SETTING_RAW_PRESSURE] = 0;

	/* Raw triggers (62): no bit, even with the trigger bits' rule off (the application's
	 * bits are cleared), and the hysteresis starts again from off. */
	memset(&s, 0, sizeof(s));
	s.trigger[OPENSC2_LEFT] = 32767;
	osc2_input_rules_apply(&r, OSC2_RULES_DEFAULT, settings, &s);
	CHECK(s.buttons & OPENSC2_CLICK_LEFT_TRIGGER);
	CHECK(r.trigger_bit[OPENSC2_LEFT]);
	settings[OPENSC2_SETTING_RAW_TRIGGERS] = 2;
	osc2_input_rules_apply(&r, OSC2_RULES_DEFAULT, settings, &s);
	CHECK_EQ(s.buttons & OPENSC2_CLICK_LEFT_TRIGGER, 0);
	CHECK(!r.trigger_bit[OPENSC2_LEFT]);
	s.buttons = OPENSC2_CLICK_LEFT_TRIGGER | OPENSC2_CLICK_RIGHT_TRIGGER;
	osc2_input_rules_apply(&r, OSC2_RULE_RAW_TRIGGERS, settings, &s);
	CHECK_EQ(s.buttons, 0);
	/* 62 back to 0: from off, at 30000 (between 85 % and 95 %) the bit stays off. */
	settings[OPENSC2_SETTING_RAW_TRIGGERS] = 0;
	s.trigger[OPENSC2_LEFT] = 30000;
	osc2_input_rules_apply(&r, OSC2_RULES_DEFAULT, settings, &s);
	CHECK_EQ(s.buttons & OPENSC2_CLICK_LEFT_TRIGGER, 0);
}

/* ---- the touch stabiliser ------------------------------------------------------------------- */

OPENSC2_TEST(input_stabiliser)
{
	struct osc2_stabiliser st;
	int32_t x, y;

	osc2_stabiliser_reset(&st);
	/* The touch-down point is the output, and held within the radius. */
	x = 100;
	y = 200;
	osc2_stabiliser_step(&st, OSC2_STABILISER_FINE, true, &x, &y);
	CHECK_EQ(x, 100);
	CHECK_EQ(y, 200);
	x = 4000;
	y = 1000;   /* approx (3900, 800) = 4027: inside */
	osc2_stabiliser_step(&st, OSC2_STABILISER_FINE, true, &x, &y);
	CHECK_EQ(x, 100);
	CHECK_EQ(y, 200);
	/* Out (approx (4900, 800) = 4972): the thumb's movement since the last sample, then an
	 * eighth of the gap plus one on each axis. */
	x = 5000;
	y = 1000;
	osc2_stabiliser_step(&st, OSC2_STABILISER_FINE, true, &x, &y);
	CHECK_EQ(x, 1100 + 3900 / 8 + 1);   /* 100 + 1000, gap 3900 */
	CHECK_EQ(y, 200 + 800 / 8 + 1);     /* no movement on y, gap 800 */
	/* The thumb stops: the gap stays. */
	x = 5000;
	y = 1000;
	osc2_stabiliser_step(&st, OSC2_STABILISER_FINE, true, &x, &y);
	CHECK_EQ(x, 1588);
	CHECK_EQ(y, 301);
	/* Rounded down: a gap of -1 is closed by 2 (one unit too far), +1 by 1. */
	st.ox = 1;
	st.px = 0;
	st.oy = -1;
	st.py = 0;
	x = -1;
	y = 1;
	osc2_stabiliser_step(&st, OSC2_STABILISER_FINE, true, &x, &y);
	CHECK_EQ(x, -2);
	CHECK_EQ(y, 1);
	/* No touch: it starts over. */
	osc2_stabiliser_step(&st, OSC2_STABILISER_FINE, false, &x, &y);
	CHECK(!st.on);
	x = -9000;
	y = 0;
	osc2_stabiliser_step(&st, OSC2_STABILISER_COARSE, true, &x, &y);
	CHECK_EQ(x, -9000);
	x = -1000;   /* 8000 away: within the coarse radius */
	osc2_stabiliser_step(&st, OSC2_STABILISER_COARSE, true, &x, &y);
	CHECK_EQ(x, -9000);

	/* The fine radius along an axis: 4443 away is still held (4369 by the approximation), 4444
	 * is out. Out once, the output follows for the rest of the touch, back inside the radius
	 * too: no second hold. */
	osc2_stabiliser_reset(&st);
	x = 0;
	y = 0;
	osc2_stabiliser_step(&st, OSC2_STABILISER_FINE, true, &x, &y);
	x = 4443;
	osc2_stabiliser_step(&st, OSC2_STABILISER_FINE, true, &x, &y);
	CHECK_EQ(x, 0);
	CHECK(st.holding);
	x = 4444;
	osc2_stabiliser_step(&st, OSC2_STABILISER_FINE, true, &x, &y);
	CHECK(!st.holding);
	CHECK_EQ(x, 1 + 4443 / 8 + 1);   /* the thumb's 1, then an eighth of the gap plus one */
	x = 100;
	osc2_stabiliser_step(&st, OSC2_STABILISER_FINE, true, &x, &y);
	CHECK_EQ(x, 557 - 4344 + 3887 / 8 + 1);   /* moved with the thumb, the gap closing */
	CHECK_EQ(y, 0);
}

/* ---- lizard mode's haptic events and what ends a glide --------------------------------------- */

OPENSC2_TEST(lizard_haptic_events)
{
	struct opensc2_haptic h[4];

	CHECK_EQ(opensc2_lizard_haptics(OPENSC2_LIZARD_KEYBOARD | OPENSC2_LIZARD_MOUSE, h), 0);
	CHECK_EQ(opensc2_lizard_haptics(OPENSC2_LIZARD_HAPTICS, h), 4);
	CHECK_EQ(h[0].target, 0);
	CHECK_EQ(h[0].command.command, OPENSC2_HAPTIC_CMD_CLICK_A);
	CHECK_EQ(h[1].target, 0);
	CHECK_EQ(h[1].command.command, OPENSC2_HAPTIC_CMD_CLICK_B);
	CHECK_EQ(h[2].target, 1);
	CHECK_EQ(h[2].command.command, OPENSC2_HAPTIC_CMD_CLICK_A);
	CHECK_EQ(h[3].target, 1);
	CHECK_EQ(h[3].command.command, OPENSC2_HAPTIC_CMD_CLICK_B);
	for (int i = 0; i < 4; i++) {
		CHECK_EQ(h[i].kind, OPENSC2_HAPTIC_COMMAND);
		CHECK_EQ(h[i].report_id, 0);   /* made by the library */
		CHECK_EQ(h[i].channels, h[i].target ? OPENSC2_HAPTIC_RIGHT_PAD :
						      OPENSC2_HAPTIC_LEFT_PAD);
		CHECK_EQ(h[i].command.gain_db,
			 h[i].command.command == OPENSC2_HAPTIC_CMD_CLICK_A ? 8 : 6);
	}
	CHECK_EQ(opensc2_lizard_haptics(OPENSC2_LIZARD_CLICK_RIGHT, h), 1);
	CHECK_EQ(h[0].channels, OPENSC2_HAPTIC_RIGHT_PAD);
}

/* A touch of 21 frames moving 2000 per frame on the right pad: the flick that glides. */
static void lz_flick(struct opensc2_lizard *lz, const int16_t *settings, uint32_t rules)
{
	struct opensc2_state s;
	uint8_t kb[9], mouse[6];

	memset(&s, 0, sizeof(s));
	s.pad[OPENSC2_RIGHT].touched = true;
	for (int i = 0; i < 21; i++) {
		s.pad[OPENSC2_RIGHT].x = (int16_t)(-21000 + 2000 * i);
		(void)lz_step(lz, &s, settings, rules, kb, mouse);
	}
}

static uint32_t lz_idle(struct opensc2_lizard *lz, const int16_t *settings, uint32_t rules,
			uint8_t mouse[6])
{
	struct opensc2_state s;
	uint8_t kb[9];

	memset(&s, 0, sizeof(s));
	return lz_step(lz, &s, settings, rules, kb, mouse);
}

static bool lz_gliding(const struct opensc2_lizard *lz, int side)
{
	return lz->pad[side].glide > 0.0f && !lz->pad[side].touched;
}

OPENSC2_TEST(lizard_glide_ends)
{
	struct opensc2_lizard lz;
	int16_t settings[OPENSC2_SETTINGS_COUNT];
	uint8_t kb[9], mouse[6];
	const uint32_t rules = OSC2_RULE_LIZARD_GLIDE;

	in_defaults(settings);
	/* The flick glides: the lift-off frame moves by the flick speed, with the remainder of the
	 * touch: (2000 + 64) / 128 = 16, 16 left. */
	opensc2_lizard_reset(&lz);
	lz_flick(&lz, settings, rules);
	CHECK_EQ(lz_idle(&lz, settings, rules, mouse), OPENSC2_LIZARD_MOUSE);
	CHECK_EQ((int8_t)mouse[2], 16);
	CHECK(lz_gliding(&lz, OPENSC2_RIGHT));
	/* The factor 1 - 1/100 in the next frame: 2000 * 0.99 = 1980, + 16 = 1996: 15. */
	CHECK_EQ(lz_idle(&lz, settings, rules, mouse), OPENSC2_LIZARD_MOUSE);
	CHECK_EQ((int8_t)mouse[2], 15);
	CHECK_EQ(lz.pad[OPENSC2_RIGHT].rem_x, 76);
	/* The resync of the test hooks zeroes the momentum: nothing after it. */
	opensc2_lizard_resync(&lz);
	CHECK(!lz_gliding(&lz, OPENSC2_RIGHT));
	CHECK_EQ(lz_idle(&lz, settings, rules, mouse), 0);
	CHECK_EQ(lz_idle(&lz, settings, rules, mouse), 0);
	/* Lizard mode turning off ends it, and turning on starts over. */
	lz_flick(&lz, settings, rules);
	(void)lz_idle(&lz, settings, rules, mouse);
	CHECK(lz_gliding(&lz, OPENSC2_RIGHT));
	CHECK_EQ(lz_setting(&lz, false, kb, mouse), OPENSC2_LIZARD_KEYBOARD | OPENSC2_LIZARD_MOUSE);
	CHECK_EQ(lz_idle(&lz, settings, rules, mouse), 0);
	(void)lz_setting(&lz, true, kb, mouse);
	CHECK(!lz_gliding(&lz, OPENSC2_RIGHT));
	CHECK_EQ(lz_idle(&lz, settings, rules, mouse), 0);
	/* The glide switched off in the middle of one ends it. */
	lz_flick(&lz, settings, rules);
	(void)lz_idle(&lz, settings, rules, mouse);
	(void)lz_idle(&lz, settings, 0, mouse);
	CHECK(!lz_gliding(&lz, OPENSC2_RIGHT));
	CHECK_EQ(lz_idle(&lz, settings, rules, mouse), 0);
	/* A new touch ends it too. */
	lz_flick(&lz, settings, rules);
	(void)lz_idle(&lz, settings, rules, mouse);
	lz_flick(&lz, settings, rules);   /* its first frame is a touch-down */
	CHECK(!lz_gliding(&lz, OPENSC2_RIGHT));
	/* Setting 12 is read in every frame: a smaller one ends it sooner. */
	(void)lz_idle(&lz, settings, rules, mouse);
	settings[OPENSC2_SETTING_MOMENTUM_DECAY] = 1;
	(void)lz_idle(&lz, settings, rules, mouse);
	CHECK(!lz_gliding(&lz, OPENSC2_RIGHT));
	settings[OPENSC2_SETTING_MOMENTUM_DECAY] = 100;
	/* A dropped link does not end it: the trackers keep what they had (no frames run). */
	lz_flick(&lz, settings, rules);
	(void)lz_idle(&lz, settings, rules, mouse);
	CHECK(lz_gliding(&lz, OPENSC2_RIGHT));
	CHECK(lz.pad[OPENSC2_RIGHT].glide < 1.0f);
}

OPENSC2_TEST(lizard_ticks_need_lizard_mode)
{
	struct opensc2_lizard lz;
	struct opensc2_state s;
	int16_t settings[OPENSC2_SETTINGS_COUNT];
	uint8_t kb[9], mouse[6];
	uint32_t made = 0;

	in_defaults(settings);
	settings[OPENSC2_SETTING_HAPTIC_INCREMENT] = 0;   /* a tick every step */
	opensc2_lizard_reset(&lz);
	memset(&s, 0, sizeof(s));
	s.pad[OPENSC2_LEFT].touched = true;
	(void)lz_step(&lz, &s, settings, OSC2_RULE_LIZARD_TICKS, kb, mouse);
	s.pad[OPENSC2_LEFT].x = 3000;
	CHECK(lz_step(&lz, &s, settings, OSC2_RULE_LIZARD_TICKS, kb, mouse) &
	      OPENSC2_LIZARD_TICK_LEFT);
	/* Setting 9 off: no step at all (the touch is forgotten) ... */
	(void)lz_setting(&lz, false, kb, mouse);
	settings[OPENSC2_SETTING_LIZARD_MODE] = 0;
	s.pad[OPENSC2_LEFT].x = 6000;
	CHECK_EQ(lz_step(&lz, &s, settings, OSC2_RULE_LIZARD_TICKS, kb, mouse), 0);
	/* ... and back on, the count starts again where the thumb is, in the same touch. */
	(void)lz_setting(&lz, true, kb, mouse);
	settings[OPENSC2_SETTING_LIZARD_MODE] = 1;
	CHECK_EQ(lz_step(&lz, &s, settings, OSC2_RULE_LIZARD_TICKS, kb, mouse), 0);
	for (int i = 0; i < 4; i++) {
		s.pad[OPENSC2_LEFT].x = (int16_t)(9000 + 3000 * i);
		made |= lz_step(&lz, &s, settings, OSC2_RULE_LIZARD_TICKS, kb, mouse);
	}
	CHECK(made & OPENSC2_LIZARD_TICK_LEFT);
	/* The click state is kept while it is off: a click pressed then plays click B when it comes
	 * back; one held through it plays nothing. */
	s.buttons = OPENSC2_CLICK_LEFT_PAD;
	settings[OPENSC2_SETTING_HAPTICS_ENABLED] = 0;
	CHECK_EQ(lz_step(&lz, &s, settings, OSC2_RULE_LIZARD_TICKS, kb, mouse) &
		 OPENSC2_LIZARD_CLICK_LEFT, 0);
	settings[OPENSC2_SETTING_HAPTICS_ENABLED] = 1;
	CHECK(lz_step(&lz, &s, settings, OSC2_RULE_LIZARD_TICKS, kb, mouse) &
	      OPENSC2_LIZARD_CLICK_LEFT);
	settings[OPENSC2_SETTING_HAPTICS_ENABLED] = 2;
	(void)lz_step(&lz, &s, settings, OSC2_RULE_LIZARD_TICKS, kb, mouse);
	settings[OPENSC2_SETTING_HAPTICS_ENABLED] = 1;
	CHECK_EQ(lz_step(&lz, &s, settings, OSC2_RULE_LIZARD_TICKS, kb, mouse) &
		 OPENSC2_LIZARD_CLICK_LEFT, 0);
	/* A click without a touch is no click. */
	s.pad[OPENSC2_LEFT].touched = false;
	CHECK(lz_step(&lz, &s, settings, OSC2_RULE_LIZARD_TICKS, kb, mouse) &
	      OPENSC2_LIZARD_CLICK_LEFT);   /* the release, as the touch ends */
	CHECK_EQ(lz_step(&lz, &s, settings, OSC2_RULE_LIZARD_TICKS, kb, mouse), 0);
}

/* ---- the radio's queue of extra reports ------------------------------------------------------ */

OPENSC2_TEST(report_queue)
{
	struct osc2_rq_item items[5];
	struct osc2_rq q;
	uint8_t r[64] = { 0x40 };

	osc2_rq_init(&q, items, 5, 3);
	CHECK(!osc2_rq_backlog(&q));
	CHECK_EQ(osc2_rq_put(&q, r, 0, false), -EINVAL);
	CHECK_EQ(osc2_rq_put(&q, r, 65, false), -EINVAL);
	/* Up to the depth everything queues. */
	for (uint8_t i = 1; i <= 3; i++) {
		r[1] = i;
		CHECK_EQ(osc2_rq_put(&q, r, 6, i == 2), 0);
	}
	CHECK(osc2_rq_backlog(&q));
	/* Past it a droppable report is dropped; the others wait behind, up to the capacity. */
	r[1] = 9;
	CHECK_EQ(osc2_rq_put(&q, r, 15, true), -ENOMEM);
	r[1] = 4;
	CHECK_EQ(osc2_rq_put(&q, r, 9, false), 0);
	r[1] = 5;
	CHECK_EQ(osc2_rq_put(&q, r, 6, false), 0);
	r[1] = 6;
	CHECK_EQ(osc2_rq_put(&q, r, 6, false), -ENOMEM);
	CHECK_EQ(q.count, 5);
	/* In order, oldest first. */
	for (uint8_t i = 0; i < 5; i++) {
		CHECK_EQ(osc2_rq_peek(&q, i)->data[1], i + 1);
	}
	CHECK_EQ(osc2_rq_peek(&q, 3)->len, 9);
	CHECK(osc2_rq_peek(&q, 5) == NULL);
	/* Two went out: the rest moves up, still in order; three left is still a backlog. */
	osc2_rq_take(&q, 2);
	CHECK_EQ(osc2_rq_peek(&q, 0)->data[1], 3);
	CHECK(osc2_rq_backlog(&q));
	osc2_rq_take(&q, 1);
	CHECK(!osc2_rq_backlog(&q));
	/* Around the end of the storage. */
	for (uint8_t i = 6; i <= 8; i++) {
		r[1] = i;
		CHECK_EQ(osc2_rq_put(&q, r, 6, false), 0);
	}
	CHECK_EQ(osc2_rq_peek(&q, 0)->data[1], 4);
	CHECK_EQ(osc2_rq_peek(&q, 4)->data[1], 8);
	osc2_rq_take(&q, 9);   /* more than there are: all */
	CHECK_EQ(q.count, 0);
	CHECK(!osc2_rq_backlog(&q));
	CHECK_EQ(osc2_rq_put(&q, r, 6, true), 0);
	osc2_rq_purge(&q);
	CHECK(osc2_rq_peek(&q, 0) == NULL);
	/* A depth of 0: lossless reports only, and any of them is a backlog. */
	osc2_rq_init(&q, items, 2, 0);
	CHECK_EQ(osc2_rq_put(&q, r, 6, true), -ENOMEM);
	CHECK_EQ(osc2_rq_put(&q, r, 6, false), 0);
	CHECK(osc2_rq_backlog(&q));
}
```
